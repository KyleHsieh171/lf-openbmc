## meta-facebook/meta-rmcv2/conf/layer.conf
```bitbake
# We have a conf and classes directory, add to BBPATH
BBPATH .= ":${LAYERDIR}"

# We have recipes-* directories, add to BBFILES
BBFILES += "${LAYERDIR}/recipes-*/*/*.bb \
            ${LAYERDIR}/recipes-*/*/*.bbappend"

BBFILE_COLLECTIONS += "rmcv2-layer"
BBFILE_PATTERN_rmcv2-layer := "^${LAYERDIR}/"

LAYERSERIES_COMPAT_rmcv2-layer := "walnascar scarthgap"
```
